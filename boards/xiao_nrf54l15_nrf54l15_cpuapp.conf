## build/Kconfig/arch/Kconfig
```kconfig
# Load Zephyr Arch Kconfig descriptions.
osource "C:/ncs/main/zephyr/arch/rx/Kconfig"
osource "C:/ncs/main/zephyr/arch/x86/Kconfig"
osource "C:/ncs/main/zephyr/arch/xtensa/Kconfig"
osource "C:/ncs/main/zephyr/arch/sparc/Kconfig"
osource "C:/ncs/main/zephyr/arch/riscv/Kconfig"
osource "C:/ncs/main/zephyr/arch/posix/Kconfig"
osource "C:/ncs/main/zephyr/arch/mips/Kconfig"
osource "C:/ncs/main/zephyr/arch/arm64/Kconfig"
osource "C:/ncs/main/zephyr/arch/arm/Kconfig"
osource "C:/ncs/main/zephyr/arch/arc/Kconfig"
```

## build/Kconfig/boards/Kconfig
```kconfig
# Load Zephyr board Kconfig descriptions.
osource "C:/ncs/main/zephyr/boards/seeed/xiao_nrf54l15/Kconfig"
```

## build/Kconfig/boards/Kconfig.defconfig
```kconfig
# Load Zephyr board defconfig descriptions.
osource "C:/ncs/main/zephyr/boards/seeed/xiao_nrf54l15/Kconfig.defconfig"
```

## build/Kconfig/boards/Kconfig.xiao_nrf54l15
```kconfig
# Load board Kconfig descriptions.
osource "C:/ncs/main/zephyr/boards/seeed/xiao_nrf54l15/Kconfig.xiao_nrf54l15"
```

## build/led_strip/Kconfig/soc/Kconfig
```kconfig
# Load Zephyr SoC Kconfig descriptions.
osource "C:/ncs/main/zephyr/soc/xlnx/zynqmp/Kconfig"
osource "C:/ncs/main/zephyr/soc/xlnx/zynq7000/Kconfig"
osource "C:/ncs/main/zephyr/soc/xlnx/versalnet/Kconfig"
osource "C:/ncs/main/zephyr/soc/xlnx/versal2/Kconfig"
osource "C:/ncs/main/zephyr/soc/xen/Kconfig"
osource "C:/ncs/main/zephyr/soc/wch/ch32v/Kconfig"
osource "C:/ncs/main/zephyr/soc/ti/simplelink/Kconfig"
osource "C:/ncs/main/zephyr/soc/ti/mspm0/Kconfig"
osource "C:/ncs/main/zephyr/soc/ti/lm3s6965/Kconfig"
osource "C:/ncs/main/zephyr/soc/ti/k3/Kconfig"
osource "C:/ncs/main/zephyr/soc/telink/tlsr/Kconfig"
osource "C:/ncs/main/zephyr/soc/starfive/jh71xx/Kconfig"
osource "C:/ncs/main/zephyr/soc/st/stm32/Kconfig"
osource "C:/ncs/main/zephyr/soc/snps/qemu_arc/Kconfig"
osource "C:/ncs/main/zephyr/soc/snps/nsim/arc_v/Kconfig"
osource "C:/ncs/main/zephyr/soc/snps/nsim/arc_classic/Kconfig"
osource "C:/ncs/main/zephyr/soc/snps/hsdk4xd/Kconfig"
osource "C:/ncs/main/zephyr/soc/snps/hsdk/Kconfig"
osource "C:/ncs/main/zephyr/soc/snps/emsk/Kconfig"
osource "C:/ncs/main/zephyr/soc/snps/emsdp/Kconfig"
osource "C:/ncs/main/zephyr/soc/snps/arc_iot/Kconfig"
osource "C:/ncs/main/zephyr/soc/silabs/Kconfig"
osource "C:/ncs/main/zephyr/soc/sifive/sifive_freedom/Kconfig"
osource "C:/ncs/main/zephyr/soc/sensry/Kconfig"
osource "C:/ncs/main/zephyr/soc/rockchip/Kconfig"
osource "C:/ncs/main/zephyr/soc/renode/riscv_virtual/Kconfig"
osource "C:/ncs/main/zephyr/soc/renode/cortex_r8_virtual/Kconfig"
osource "C:/ncs/main/zephyr/soc/renesas/smartbond/Kconfig"
osource "C:/ncs/main/zephyr/soc/renesas/rz/Kconfig"
osource "C:/ncs/main/zephyr/soc/renesas/rx/Kconfig"
osource "C:/ncs/main/zephyr/soc/renesas/rcar/Kconfig"
osource "C:/ncs/main/zephyr/soc/renesas/ra/Kconfig"
osource "C:/ncs/main/zephyr/soc/realtek/ec/Kconfig"
osource "C:/ncs/main/zephyr/soc/raspberrypi/rpi_pico/Kconfig"
osource "C:/ncs/main/zephyr/soc/quicklogic/eos_s3/Kconfig"
osource "C:/ncs/main/zephyr/soc/qemu/virt_riscv/Kconfig"
osource "C:/ncs/main/zephyr/soc/qemu/malta/Kconfig"
osource "C:/ncs/main/zephyr/soc/openisa/rv32m1/Kconfig"
osource "C:/ncs/main/zephyr/soc/openhwgroup/cva6/Kconfig"
osource "C:/ncs/main/zephyr/soc/oct/osd32mp15x/Kconfig"
osource "C:/ncs/main/zephyr/soc/nxp/s32/Kconfig"
osource "C:/ncs/main/zephyr/soc/nxp/rw/Kconfig"
osource "C:/ncs/main/zephyr/soc/nxp/mcx/Kconfig"
osource "C:/ncs/main/zephyr/soc/nxp/lpc/Kconfig"
osource "C:/ncs/main/zephyr/soc/nxp/layerscape/Kconfig"
osource "C:/ncs/main/zephyr/soc/nxp/kinetis/Kconfig"
osource "C:/ncs/main/zephyr/soc/nxp/imxrt/Kconfig"
osource "C:/ncs/main/zephyr/soc/nxp/imx/Kconfig"
osource "C:/ncs/main/zephyr/soc/nuvoton/numicro/Kconfig"
osource "C:/ncs/main/zephyr/soc/nuvoton/numaker/Kconfig"
osource "C:/ncs/main/zephyr/soc/nuvoton/npcx/Kconfig"
osource "C:/ncs/main/zephyr/soc/nuvoton/npcm/Kconfig"
osource "C:/ncs/main/zephyr/soc/nordic/Kconfig"
osource "C:/ncs/main/zephyr/soc/neorv32/Kconfig"
osource "C:/ncs/main/zephyr/soc/native/inf_clock/Kconfig"
osource "C:/ncs/main/zephyr/soc/microchip/sam/Kconfig"
osource "C:/ncs/main/zephyr/soc/microchip/sam/sam_d5x_e5x/Kconfig"
osource "C:/ncs/main/zephyr/soc/microchip/miv/Kconfig"
osource "C:/ncs/main/zephyr/soc/microchip/mec/Kconfig"
osource "C:/ncs/main/zephyr/soc/mediatek/mt8xxx/Kconfig"
osource "C:/ncs/main/zephyr/soc/lowrisc/opentitan/Kconfig"
osource "C:/ncs/main/zephyr/soc/litex/litex_vexriscv/Kconfig"
osource "C:/ncs/main/zephyr/soc/ite/ec/Kconfig"
osource "C:/ncs/main/zephyr/soc/intel/raptor_lake/Kconfig"
osource "C:/ncs/main/zephyr/soc/intel/panther_lake/Kconfig"
osource "C:/ncs/main/zephyr/soc/intel/lakemont/Kconfig"
osource "C:/ncs/main/zephyr/soc/intel/intel_socfpga_std/Kconfig"
osource "C:/ncs/main/zephyr/soc/intel/intel_socfpga/Kconfig"
osource "C:/ncs/main/zephyr/soc/intel/intel_niosv/Kconfig"
osource "C:/ncs/main/zephyr/soc/intel/intel_ish/Kconfig"
osource "C:/ncs/main/zephyr/soc/intel/intel_adsp/Kconfig"
osource "C:/ncs/main/zephyr/soc/intel/elkhart_lake/Kconfig"
osource "C:/ncs/main/zephyr/soc/intel/atom/Kconfig"
osource "C:/ncs/main/zephyr/soc/intel/apollo_lake/Kconfig"
osource "C:/ncs/main/zephyr/soc/intel/alder_lake/Kconfig"
osource "C:/ncs/main/zephyr/soc/infineon/cat3/Kconfig"
osource "C:/ncs/main/zephyr/soc/infineon/cat1c/Kconfig"
osource "C:/ncs/main/zephyr/soc/infineon/cat1b/Kconfig"
osource "C:/ncs/main/zephyr/soc/infineon/cat1a/Kconfig"
osource "C:/ncs/main/zephyr/soc/gd/gd32/Kconfig"
osource "C:/ncs/main/zephyr/soc/gaisler/leon3/Kconfig"
osource "C:/ncs/main/zephyr/soc/gaisler/gr716a/Kconfig"
osource "C:/ncs/main/zephyr/soc/espressif/Kconfig"
osource "C:/ncs/main/zephyr/soc/ene/kb1200/Kconfig"
osource "C:/ncs/main/zephyr/soc/ene/kb106x/Kconfig"
osource "C:/ncs/main/zephyr/soc/efinix/sapphire/Kconfig"
osource "C:/ncs/main/zephyr/soc/cdns/xtensa_sample_controller/Kconfig"
osource "C:/ncs/main/zephyr/soc/cdns/sample_controller32/Kconfig"
osource "C:/ncs/main/zephyr/soc/cdns/dc233c/Kconfig"
osource "C:/ncs/main/zephyr/soc/brcm/bcmvk/Kconfig"
osource "C:/ncs/main/zephyr/soc/brcm/bcm2712/Kconfig"
osource "C:/ncs/main/zephyr/soc/brcm/bcm2711/Kconfig"
osource "C:/ncs/main/zephyr/soc/bflb/Kconfig"
osource "C:/ncs/main/zephyr/soc/atmel/sam0/Kconfig"
osource "C:/ncs/main/zephyr/soc/atmel/sam/Kconfig"
osource "C:/ncs/main/zephyr/soc/aspeed/Kconfig"
osource "C:/ncs/main/zephyr/soc/arm/Kconfig"
osource "C:/ncs/main/zephyr/soc/arm/beetle/Kconfig"
osource "C:/ncs/main/zephyr/soc/antmicro/myra/Kconfig"
osource "C:/ncs/main/zephyr/soc/andestech/Kconfig"
osource "C:/ncs/main/zephyr/soc/amd/acp_6_0/Kconfig"
osource "C:/ncs/main/zephyr/soc/ambiq/Kconfig"
osource "C:/ncs/main/zephyr/soc/aesc/Kconfig"
osource "C:/ncs/main/zephyr/soc/adi/max32/Kconfig"
osource "C:/ncs/main/nrf/soc/sercomm/nrf91/Kconfig"
osource "C:/ncs/main/nrf/soc/nordic/Kconfig"
```
